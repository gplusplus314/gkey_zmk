## boards/shields/gkey_vibraphone/Kconfig.shield
```kconfig
# Copyright (c) 2022 The ZMK Contributors
# SPDX-License-Identifier: MIT

config SHIELD_GKEY_VIBRAPHONE_LEFT
	def_bool $(shields_list_contains,gkey_vibraphone_left)

config SHIELD_GKEY_VIBRAPHONE_RIGHT
	def_bool $(shields_list_contains,gkey_vibraphone_right)
```
